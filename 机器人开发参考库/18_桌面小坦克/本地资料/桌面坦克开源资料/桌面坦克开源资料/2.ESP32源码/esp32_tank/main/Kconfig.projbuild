## 机器人开发参考库/18_桌面小坦克/本地资料/桌面坦克开源资料/桌面坦克开源资料/2.ESP32源码/esp32_tank/main/Kconfig.projbuild
```kconfig
menu "Tank WiFi Configuration"

    config TANK_WIFI_SSID
        string "WiFi SSID (fallback if NVS empty)"
        default "myssid"
        help
            Used only when no WiFi saved in NVS. Leave as myssid to force Captive Portal.

    config TANK_WIFI_PASSWORD
        string "WiFi Password (fallback)"
        default "mypassword"

    config TANK_AP_SSID
        string "Captive Portal AP SSID"
        default "ESP32-Tank-Setup"
        help
            SoftAP name shown during provisioning.

    config TANK_AP_PASSWORD
        string "Captive Portal AP Password"
        default ""
        help
            Leave empty for open AP. Minimum 8 characters for WPA2.

    config TANK_MDNS_HOSTNAME
        string "mDNS hostname"
        default "tank"
        help
            Access at http://<hostname>.local after provisioning.

    config TANK_USE_HTTPS
        bool "Enable HTTPS in control mode"
        default n
        help
            Use self-signed TLS on port 443. HTTP port 80 redirects to HTTPS.
            Captive Portal always uses plain HTTP.

    config TANK_CMD_TIMEOUT_MS
        int "Command timeout (ms)"
        default 500
        range 200 3000
        help
            Stop motors if no WebSocket command is received within this time.

endmenu
```

## 机器人开发参考库/18_桌面小坦克/本地资料/桌面坦克开源资料/桌面坦克开源资料/2.ESP32源码/esp32_tank/sdkconfig.defaults
```kconfig
CONFIG_IDF_TARGET="esp32s3"

CONFIG_HTTPD_WS_SUPPORT=y
CONFIG_TANK_MDNS_HOSTNAME="tank"
CONFIG_TANK_AP_SSID="ESP32-Tank-Setup"
```
