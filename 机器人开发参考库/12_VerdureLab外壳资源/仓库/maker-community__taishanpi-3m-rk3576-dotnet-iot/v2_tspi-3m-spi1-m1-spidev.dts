/dts-v1/;
/plugin/;

&spi1 {
    status = "okay";
    #address-cells = <1>;
    #size-cells = <0>;

    pinctrl-names = "default";
    pinctrl-0 = <&spi1m1_csn0 &spi1m1_pins>;

    num-cs = <1>;
    max-freq = <50000000>;

    spidev@0 {
        compatible = "rohm,dh2228fv";
        status = "okay";
        reg = <0>;
        spi-max-frequency = <50000000>;
    };
};